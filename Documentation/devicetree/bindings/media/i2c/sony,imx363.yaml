## Documentation/devicetree/bindings/media/i2c/sony,imx363.yaml
```yaml
# SPDX-License-Identifier: (GPL-2.0-only OR BSD-2-Clause)
%YAML 1.2
---
$id: http://devicetree.org/schemas/media/i2c/sony,imx363.yaml#
$schema: http://devicetree.org/meta-schemas/core.yaml#

title: Sony IMX363 12 Mpixel CMOS Digital Image Sensor

maintainers:
  - David Heidelberg <linux-next@seznam.cz>

description:
  IMX363 is a 12 Mega-pixel CMOS active pixel type stacked image sensor with a
  square pixel array of size 4048 x 3168. It is programmable through an I2C
  interface. Image data is sent through MIPI CSI-2, over two or four data
  lanes.

$ref: /schemas/media/video-interface-devices.yaml#

properties:
  compatible:
    const: sony,imx363

  reg:
    maxItems: 1

  clocks:
    description: EXTCLK, 24 MHz.
    maxItems: 1

  reset-gpios:
    description:
      Reference to the GPIO connected to the XCLR pin, if any.
    maxItems: 1

  vana-supply:
    description: Analog voltage (VANA) supply, 2.8 V

  vdig-supply:
    description: Digital core voltage (VDIG) supply, 1.2 V

  vif-supply:
    description: Interface voltage (VIF) supply, 1.8 V

  port:
    $ref: /schemas/graph.yaml#/$defs/port-base
    additionalProperties: false

    properties:
      endpoint:
        $ref: /schemas/media/video-interfaces.yaml#
        unevaluatedProperties: false

        properties:
          data-lanes:
            oneOf:
              - items:
                  - const: 1
                  - const: 2
              - items:
                  - const: 1
                  - const: 2
                  - const: 3
                  - const: 4

          link-frequencies: true

        required:
          - data-lanes
          - link-frequencies

    required:
      - endpoint

required:
  - compatible
  - reg
  - clocks
  - vana-supply
  - vdig-supply
  - vif-supply
  - port

unevaluatedProperties: false

examples:
  - |
    #include <dt-bindings/gpio/gpio.h>

    i2c {
        #address-cells = <1>;
        #size-cells = <0>;

        sensor@10 {
            compatible = "sony,imx363";
            reg = <0x10>;

            clocks = <&imx363_clk>;

            vana-supply = <&cam_vana_2v8>;
            vdig-supply = <&cam_vdig_1v2>;
            vif-supply = <&cam_vif_1v8>;

            reset-gpios = <&tlmm 9 GPIO_ACTIVE_LOW>;

            orientation = <0>;
            rotation = <0>;

            port {
                imx363_ep: endpoint {
                    remote-endpoint = <&csiphy_ep>;
                    data-lanes = <1 2 3 4>;
                    link-frequencies = /bits/ 64 <636000000>;
                };
            };
        };
    };

    /* Oscillator on the camera board */
    imx363_clk: clock {
        compatible = "fixed-clock";
        #clock-cells = <0>;
        clock-frequency = <24000000>;
    };
...
```
